## Kconfig
```kconfig
# SPDX-License-Identifier: MIT

config NOCFREE_KSCAN_PCA9555
    bool "NocFree PCA9555 key-input scanner"
    default y
    depends on DT_HAS_NOCFREE_KSCAN_PCA9555_ENABLED
    select I2C
    select KSCAN
    select ZMK_DEBOUNCE
    help
      Poll PCA9555-compatible I2C expanders that are wired as independent key
      inputs and report them through ZMK's KSCAN interface.

      The driver owns the expander registers directly instead of layering on
      Zephyr's generic PCA GPIO driver. See docs/architecture.md for why that
      is required on the ZMK-pinned Zephyr revision.

if NOCFREE_KSCAN_PCA9555

config NOCFREE_KSCAN_PCA9555_INIT_PRIORITY
    int "NocFree PCA9555 scanner init priority"
    default 90
    help
      Must be later than CONFIG_I2C_INIT_PRIORITY so the bus is available when
      the scanner writes and verifies the expander configuration.

config NOCFREE_KSCAN_PCA9555_STACK_SIZE
    int "NocFree PCA9555 scan thread stack size"
    default 1024
    help
      Stack for the dedicated scan queue. The scan itself is shallow; the depth
      is the synchronous I2C transfer.

config NOCFREE_KSCAN_PCA9555_PRIORITY
    int "NocFree PCA9555 scan thread priority"
    default 4
    help
      Preemptible priority for the scan queue. Scanning must not run on the
      cooperative system work queue, where each blocking expander read would
      delay the key events the scan has just produced and, on a split central,
      the events arriving from the peripheral.

endif # NOCFREE_KSCAN_PCA9555

config NOCFREE_RECOVERY_CDC_1200_TOUCH
    bool "Enter the preserved UF2 bootloader when CDC baud is set to 1200"
    default y
    depends on USB_CDC_ACM && CDC_ACM_DTE_RATE_CALLBACK_SUPPORT
    depends on DT_HAS_ZEPHYR_CDC_ACM_UART_ENABLED
    depends on RETENTION_BOOT_MODE
    help
      Provide the conventional 1200-baud touch recovery trigger on a USB CDC
      interface. Unlike the keymap's &bootloader binding -- which acts on the
      half whose key triggered it and, for a split peripheral, needs a working
      split link -- this path only needs USB, so it recovers a half no matter
      what state its radio or pairing is in.

config NOCFREE_PAD_I2C_DIAGNOSTIC
    bool "Periodically report NocFree Pad PCA9555 registers"
    default n
    depends on I2C && LOG
    help
      Read the three Pad expanders every two seconds and report their input,
      polarity and configuration registers over the selected logging backend.
      This is a temporary read-only fault-isolation feature.

config NOCFREE_BATTERY_DIAGNOSTIC
    bool "Report split-peripheral battery events over USB logging (unsafe legacy diagnostic)"
    default n
    depends on ZMK_SPLIT_ROLE_CENTRAL
    depends on ZMK_SPLIT_BLE_CENTRAL_BATTERY_LEVEL_FETCHING
    depends on LOG
    help
      Print the split source index and reported state of charge whenever the
      dongle receives a peripheral battery event. This is intended only for a
      temporary USB diagnostic image. Do not enable this on the pinned ZMK
      revision: non-split BLE disconnects can produce an invalid source index.

config NOCFREE_LOCAL_BATTERY_DIAGNOSTIC
    bool "Report one half's local battery voltage over USB logging"
    default n
    depends on ZMK_BATTERY
    depends on LOG
    help
      Sample the chosen local battery sensor every five seconds and print both
      millivolts and the driver's percentage. This diagnostic does not use the
      split-central battery subscription path.

config NOCFREE_BATTERY_ADC_PROBE
    bool "Compare NocFree battery ADC with its divider disabled and enabled"
    default n
    depends on ADC
    depends on GPIO
    depends on LOG
    help
      Read the verified AIN2 input with the verified divider-enable GPIO first
      inactive and then active. Print the raw ADC counts, pin millivolts, and
      both the previous and hardware-calibrated ZMK conversions over USB
      logging.

config NOCFREE_LOW_BATTERY_LED_PROBE
    bool "Safely pulse the NocFree shared red charge indicator"
    default n
    depends on GPIO
    depends on ZMK_USB
    depends on DT_HAS_NOCFREE_OPEN_DRAIN_INDICATOR_ENABLED
    help
      Temporary hardware-validation firmware. Keep the shared red indicator
      electrically released while hardware VBUS is present. After VBUS is
      removed, alternate between open-drain low and electrical release every
      three seconds. This does not implement the final low-battery policy.

config NOCFREE_LOW_BATTERY_INDICATOR
    bool "NocFree local low-battery red LED warning"
    default y
    depends on GPIO
    depends on SOC_NRF52833
    depends on ZMK_BATTERY_REPORTING
    depends on DT_HAS_NOCFREE_OPEN_DRAIN_INDICATOR_ENABLED
    help
      Monitor only this keyboard half's local ZMK battery state. At 15 percent
      or below, pulse the shared red charge/low-battery indicator twice every
      minute while VBUS is absent. The output is active-low open drain and is
      always electrically released while USB power is present.

config NOCFREE_BATTERY_STATUS
    bool "NocFree on-demand battery status on the dongle RGB LED"
    default y
    depends on SHIELD_NOCFREE_AND_DONGLE
    depends on ZMK_SPLIT_ROLE_CENTRAL
    depends on BT_CENTRAL && BT_GATT_CLIENT
    help
      When the battery-status behavior is pressed, read the standard Battery
      Service from split slots 0, 1, and 2, with explicit bounds checks, and
      show left, right, then Pad on the XIAO RGB LED. This deliberately leaves
      ZMK's continuous split-central battery fetching disabled.
```

## boards/nocfree/nocfree_and/Kconfig.defconfig
```kconfig
# SPDX-License-Identifier: MIT

if BOARD_NOCFREE_AND_LEFT

config ZMK_KEYBOARD_NAME
    default "NocFree &"

# The left half is the split central and the half that talks to the host.
config ZMK_SPLIT_ROLE_CENTRAL
    default y

endif # BOARD_NOCFREE_AND_LEFT

if BOARD_NOCFREE_AND_RIGHT

config ZMK_KEYBOARD_NAME
    default "NocFree & Right"

endif # BOARD_NOCFREE_AND_RIGHT

if BOARD_NOCFREE_AND_PAD

config ZMK_KEYBOARD_NAME
    default "NocFree Pad"

endif # BOARD_NOCFREE_AND_PAD

if BOARD_NOCFREE_AND_LEFT || BOARD_NOCFREE_AND_RIGHT || BOARD_NOCFREE_AND_PAD

config BOARD
    default "nocfree_and"

config ZMK_SPLIT
    default y

endif # BOARD_NOCFREE_AND_LEFT || BOARD_NOCFREE_AND_RIGHT || BOARD_NOCFREE_AND_PAD
```

## boards/shields/nocfree_and/Kconfig.shield
```kconfig
# SPDX-License-Identifier: MIT

config SHIELD_NOCFREE_AND_DONGLE
    def_bool $(shields_list_contains,nocfree_and_dongle)
```

## dts/bindings/behaviors/nocfree,behavior-battery-status.yaml
```yaml
# SPDX-License-Identifier: MIT

description: NocFree on-demand split battery status behavior

compatible: "nocfree,behavior-battery-status"

include: zero_param.yaml
```

## dts/bindings/behaviors/nocfree,behavior-bt-output.yaml
```yaml
# SPDX-License-Identifier: MIT

description: NocFree atomic Bluetooth profile and output selection behavior

compatible: "nocfree,behavior-bt-output"

include: one_param.yaml
```

## dts/bindings/misc/nocfree,open-drain-indicator.yaml
```yaml
# SPDX-License-Identifier: MIT

description: |
  NocFree indicator line shared with the charging circuit. Consumers must
  configure the GPIO as open drain and must never actively drive it high.

compatible: "nocfree,open-drain-indicator"

include: base.yaml

properties:
  gpios:
    type: phandle-array
    required: true
    description: Active-low, open-drain indicator GPIO.
```
