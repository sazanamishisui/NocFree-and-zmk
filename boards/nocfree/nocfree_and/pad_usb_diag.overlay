/* SPDX-License-Identifier: MIT */

/*
 * Reuse the board's recovery CDC port as the USB logging console. The live
 * v0.6.2 capture proved that this Pad has responders at 0x20 and 0x22 only.
 * Scan all 32 input bits so the physical 21-key wiring can be discovered
 * without carrying the incorrect third-expander assumption into production.
 */
/ {
    chosen {
        zephyr,console = &cdc_acm_uart0;
        zephyr,shell-uart = &cdc_acm_uart0;
    };
};

&kscan0 {
    /delete-property/ expanders;
    expanders = <&pca20>, <&pca22>;

    /delete-property/ key-inputs;
    key-inputs =
        <&pca20 0>, <&pca20 1>, <&pca20 2>, <&pca20 3>,
        <&pca20 4>, <&pca20 5>, <&pca20 6>, <&pca20 7>,
        <&pca20 8>, <&pca20 9>, <&pca20 10>, <&pca20 11>,
        <&pca20 12>, <&pca20 13>, <&pca20 14>, <&pca20 15>,
        <&pca22 0>, <&pca22 1>, <&pca22 2>, <&pca22 3>,
        <&pca22 4>, <&pca22 5>, <&pca22 6>, <&pca22 7>,
        <&pca22 8>, <&pca22 9>, <&pca22 10>, <&pca22 11>,
        <&pca22 12>, <&pca22 13>, <&pca22 14>, <&pca22 15>;
};

&matrix_transform0 {
    /delete-property/ col-offset;
    /delete-property/ map;
    columns = <32>;
    map = <
         0  1  2  3  4  5  6  7
         8  9 10 11 12 13 14 15
        16 17 18 19 20 21 22 23
        24 25 26 27 28 29 30 31
    >;
};
